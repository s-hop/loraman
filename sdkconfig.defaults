## sdkconfig.defaults
```kconfig
CONFIG_ESP_COREDUMP_ENABLE_TO_FLASH=y
CONFIG_ESP_SYSTEM_USE_FRAME_POINTER=y
CONFIG_ESPTOOLPY_FLASHSIZE_4MB=y
CONFIG_FREERTOS_HZ=1000
CONFIG_PARTITION_TABLE_CUSTOM=y
CONFIG_UART_ISR_IN_IRAM=y
```
